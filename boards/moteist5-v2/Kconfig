## boards/moteist5-v2/Kconfig
```kconfig
# Copyright (c) 2020 HAW Hamburg
#
# This file is subject to the terms and conditions of the GNU Lesser
# General Public License v2.1. See the file LICENSE in the top level
# directory for more details.

config BOARD
    default "MOTEIST5-V2" if BOARD_MOTEIST5-V2

config BOARD_MOTEIST5-V2
    bool
    default y
    select CPU_MODEL_MSP430F5438A
    select HAS_PERIPH_GPIO
    select HAS_PERIPH_GPIO_IRQ
    select HAS_PERIPH_SPI
    select HAS_PERIPH_TIMER
    select HAS_PERIPH_UART
```

## cpu/msp430f5xyz/Kconfig
```kconfig
# Copyright (c) 2020 Freie Universität Berlin
#               2020 HAW Hamburg
#
# This file is subject to the terms and conditions of the GNU Lesser
# General Public License v2.1. See the file LICENSE in the top level
# directory for more details.
#

config CPU_FAM_MSP430F5
    bool
    select CPU_CORE_MSP430
    select HAS_CPU_MSP430F5XYZ

## CPU Models
config CPU_MODEL_MSP430F5438A
    bool
    select CPU_FAM_MSP430F5

## Definition of specific features
config HAS_CPU_MSP430F5XYZ
    bool
    help
        Indicates that an 'msp430f5xyz' cpu is being used.

## Common CPU symbols
config CPU_FAM
    default "msp430f5" if CPU_FAM_MSP430F5

config CPU_MODEL
    default "msp430f5438a" if CPU_MODEL_MSP430F5438A

config CPU
    default "msp430f5xyz" if CPU_FAM_MSP430F5

source "$(RIOTCPU)/msp430_common/Kconfig"
```
